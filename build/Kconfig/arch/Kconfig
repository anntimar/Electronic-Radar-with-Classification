## build/Kconfig/arch/Kconfig
```kconfig
# Load Zephyr Arch Kconfig descriptions.
osource "/home/mariaantonia/zephyrproject/zephyr/arch/rx/Kconfig"
osource "/home/mariaantonia/zephyrproject/zephyr/arch/x86/Kconfig"
osource "/home/mariaantonia/zephyrproject/zephyr/arch/xtensa/Kconfig"
osource "/home/mariaantonia/zephyrproject/zephyr/arch/sparc/Kconfig"
osource "/home/mariaantonia/zephyrproject/zephyr/arch/riscv/Kconfig"
osource "/home/mariaantonia/zephyrproject/zephyr/arch/posix/Kconfig"
osource "/home/mariaantonia/zephyrproject/zephyr/arch/mips/Kconfig"
osource "/home/mariaantonia/zephyrproject/zephyr/arch/arm64/Kconfig"
osource "/home/mariaantonia/zephyrproject/zephyr/arch/arm/Kconfig"
osource "/home/mariaantonia/zephyrproject/zephyr/arch/arc/Kconfig"
```

## build/Kconfig/boards/Kconfig.defconfig
```kconfig
# Load Zephyr board defconfig descriptions.
osource "/home/mariaantonia/zephyrproject/zephyr/boards/arm/mps2/Kconfig.defconfig"
```

## build/Kconfig/boards/Kconfig.mps2
```kconfig
# Load board Kconfig descriptions.
osource "/home/mariaantonia/zephyrproject/zephyr/boards/arm/mps2/Kconfig.mps2"
```

## tests/plate/testcase.yaml
```yaml
tests:
  radar.plate:
    platform_allow:
      - native_sim_64
      - mps2_an385
    tags:
      - radar
      - plate
    harness: ztest
```

## tests/speed/testcase.yaml
```yaml
tests:
  radar.speed:
    platform_allow:
      - native_sim_64
      - mps2_an385
    tags:
      - radar
      - speed
    harness: ztest
```
