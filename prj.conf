## CMakeLists.txt
```
cmake_minimum_required(VERSION 3.20.0)

find_package(Zephyr REQUIRED HINTS $ENV{ZEPHYR_BASE})
project(radar)

target_sources(app PRIVATE
    src/main.c
    src/sensors.c
    src/camera.c
    src/display.c
    src/utils.c
    src/control.c
)

target_include_directories(app PRIVATE include)
```

## Kconfig
```
# SPDX-License-Identifier: Apache-2.0
source "Kconfig.zephyr"

menu "Radar configuration"

config RADAR_SENSOR_DISTANCE_MM
    int "Distância entre os sensores (mm)"
    default 2000
    help
      Distância física entre os dois sensores magnéticos simulados.

config RADAR_SPEED_LIMIT_LIGHT_KMH
    int "Limite de velocidade para veículos leves (km/h)"
    default 80

config RADAR_SPEED_LIMIT_HEAVY_KMH
    int "Limite de velocidade para veículos pesados (km/h)"
    default 60

config RADAR_WARNING_THRESHOLD_PERCENT
    int "Percentual para zona de alerta (cor amarela)"
    default 90
    range 50 100

config RADAR_CAMERA_FAILURE_RATE_PERCENT
    int "Taxa de falha simulada da câmera (0-100 %)"
    default 20
    range 0 100

endmenu
```

## prj.conf
```kconfig
# Kernel / threads
CONFIG_MAIN_STACK_SIZE=2048
CONFIG_SYSTEM_WORKQUEUE_STACK_SIZE=2048
CONFIG_THREAD_STACK_INFO=y

# Logs / console
CONFIG_PRINTK=y
CONFIG_LOG=y
CONFIG_LOG_DEFAULT_LEVEL=3
CONFIG_CONSOLE=y
CONFIG_UART_CONSOLE=y
CONFIG_STDOUT_CONSOLE=y

# ZBUS
CONFIG_ZBUS=y

# Gerador de número aleatório genérico (para sys_rand32_get)
CONFIG_TEST_RANDOM_GENERATOR=y
```

## app.overlay
```dts
/*
 * Overlay opcional.
 * Para este projeto, o feedback visual é feito via console usando printk
 * com códigos ANSI. Se desejar usar o driver Display Dummy de fato,
 * ajuste este overlay de acordo com o seu board.
 */
```

## src/main.c
```c
#include <zephyr/kernel.h>
#include <zephyr/logging/log.h>
#include <zephyr/zbus/zbus.h>

#include "radar.h"

LOG_MODULE_REGISTER(radar_main, LOG_LEVEL_INF);

/* Mensagem usada no canal ZBUS da câmera */
struct camera_msg {
    bool trigger;      /* true para disparar captura */
    bool done;         /* true quando placa foi gerada */
    bool plate_valid;  /* se a placa é válida */
    char plate[16];    /* placa gerada */
};

/* Canal de comunicação via ZBUS (controle <-> câmera) */
ZBUS_CHAN_DEFINE(camera_chan,
                 struct camera_msg,
                 NULL, /* validator */
                 NULL, /* user data */
                 ZBUS_OBSERVERS_EMPTY,
                 ZBUS_MSG_INIT(.trigger = false, .done = false));

/* Filas globais declaradas em radar.h */
K_MSGQ_DEFINE(g_sensor_msgq, sizeof(struct sensor_sample), 8, 4);
K_MSGQ_DEFINE(g_display_msgq, sizeof(struct display_msg), 8, 4);

/* Pilhas de threads */
K_THREAD_STACK_DEFINE(sensor_stack,  RADAR_STACK_SIZE);
K_THREAD_STACK_DEFINE(control_stack, RADAR_STACK_SIZE);
K_THREAD_STACK_DEFINE(display_stack, RADAR_STACK_SIZE);
K_THREAD_STACK_DEFINE(camera_stack,  RADAR_STACK_SIZE);

static struct k_thread sensor_thread_data;
static struct k_thread control_thread_data;
static struct k_thread display_thread_data;
static struct k_thread camera_thread_data;

void main(void)
{
    LOG_INF("Radar eletrônico iniciado");

    k_thread_create(&sensor_thread_data, sensor_stack, K_THREAD_STACK_SIZEOF(sensor_stack),
                    sensors_thread, NULL, NULL, NULL,
                    RADAR_PRIORITY, 0, K_NO_WAIT);

    k_thread_create(&control_thread_data, control_stack, K_THREAD_STACK_SIZEOF(control_stack),
                    control_thread, NULL, NULL, NULL,
                    RADAR_PRIORITY, 0, K_NO_WAIT);

    k_thread_create(&display_thread_data, display_stack, K_THREAD_STACK_SIZEOF(display_stack),
                    display_thread, NULL, NULL, NULL,
                    RADAR_PRIORITY, 0, K_NO_WAIT);

    k_thread_create(&camera_thread_data, camera_stack, K_THREAD_STACK_SIZEOF(camera_stack),
                    camera_thread, NULL, NULL, NULL,
                    RADAR_PRIORITY, 0, K_NO_WAIT);

    /* Opcional: dar nomes às threads para debug */
    k_thread_name_set(&sensor_thread_data, "sensors");
    k_thread_name_set(&control_thread_data, "control");
    k_thread_name_set(&display_thread_data, "display");
    k_thread_name_set(&camera_thread_data, "camera");
}
```

## include/radar.h
```c
#pragma once
#include <zephyr/kernel.h>
#include <stdbool.h>
#include <stdint.h>

typedef enum {
    VEHICLE_TYPE_LIGHT = 0,
    VEHICLE_TYPE_HEAVY = 1,
} vehicle_type_t;

typedef enum {
    RADAR_STATUS_NORMAL = 0,
    RADAR_STATUS_WARNING,
    RADAR_STATUS_INFRACTION,
} radar_status_t;

struct sensor_sample {
    uint32_t axes;        /* número de eixos detectados */
    uint32_t speed_kmh;   /* velocidade simulada */
};

struct display_msg {
    struct sensor_sample sample;
    radar_status_t status;
    char plate[16];
    bool plate_valid;
};

/* Fila de comunicação sensor -> controle */
extern struct k_msgq g_sensor_msgq;

/* Fila de comunicação controle -> display */
extern struct k_msgq g_display_msgq;

/* Pilhas de threads */
#define RADAR_STACK_SIZE 2048
#define RADAR_PRIORITY   5

/* Funções utilitárias */
uint32_t radar_calc_speed_kmh(uint32_t distance_mm, uint32_t time_ms);
vehicle_type_t radar_classify_vehicle(uint32_t axes);
bool radar_validate_plate(const char *plate);
void radar_generate_plate(char *out, size_t len, bool *valid);

/* Entrypoints de threads */
void sensors_thread(void *p1, void *p2, void *p3);
void control_thread(void *p1, void *p2, void *p3);
void display_thread(void *p1, void *p2, void *p3);
void camera_thread(void *p1, void *p2, void *p3);
```

## src/camera.c
```c
#include <string.h>
#include <zephyr/kernel.h>
#include <zephyr/logging/log.h>
#include <zephyr/zbus/zbus.h>

#include "radar.h"

LOG_MODULE_REGISTER(radar_camera, LOG_LEVEL_INF);

/* Estrutura e canal definidos em main.c */
struct camera_msg {
    bool trigger;
    bool done;
    bool plate_valid;
    char plate[16];
};

extern const struct zbus_channel camera_chan;

void camera_thread(void *p1, void *p2, void *p3)
{
    ARG_UNUSED(p1);
    ARG_UNUSED(p2);
    ARG_UNUSED(p3);

    struct camera_msg msg;

    while (1) {
        /* Bloqueia até conseguir ler o último estado do canal */
        int err = zbus_chan_read(&camera_chan, &msg, K_FOREVER);
        if (err != 0) {
            LOG_ERR("Falha ao ler canal da camera: %d", err);
            continue;
        }

        if (!msg.trigger) {
            /* Nada a fazer, apenas aguarda novo trigger */
            continue;
        }

        LOG_INF("Camera acionada, processando placa...");
        k_sleep(K_MSEC(500)); /* simula tempo de processamento */

        bool valid = false;
        radar_generate_plate(msg.plate, sizeof(msg.plate), &valid);
        msg.plate_valid = valid;
        msg.done = true;
        msg.trigger = false;

        err = zbus_chan_pub(&camera_chan, &msg, K_MSEC(100));
        if (err != 0) {
            LOG_ERR("Falha ao publicar resultado da camera: %d", err);
        } else {
            LOG_INF("Camera publicou placa: %s (%s)",
                    msg.plate,
                    msg.plate_valid ? "valida" : "invalida");
        }
    }
}
```

## src/control.c
```c
#include <zephyr/kernel.h>
#include <zephyr/logging/log.h>
#include <zephyr/zbus/zbus.h>

#include "radar.h"

LOG_MODULE_REGISTER(radar_control, LOG_LEVEL_INF);

struct camera_msg {
    bool trigger;
    bool done;
    bool plate_valid;
    char plate[16];
};

extern const struct zbus_channel camera_chan;

void control_thread(void *p1, void *p2, void *p3)
{
    ARG_UNUSED(p1);
    ARG_UNUSED(p2);
    ARG_UNUSED(p3);

    uint32_t limit_light = CONFIG_RADAR_SPEED_LIMIT_LIGHT_KMH;
    uint32_t limit_heavy = CONFIG_RADAR_SPEED_LIMIT_HEAVY_KMH;
    uint32_t warn_pct = CONFIG_RADAR_WARNING_THRESHOLD_PERCENT;

    while (1) {
        struct sensor_sample sample;

        if (k_msgq_get(&g_sensor_msgq, &sample, K_FOREVER) != 0) {
            continue;
        }

        vehicle_type_t type = radar_classify_vehicle(sample.axes);
        uint32_t limit = (type == VEHICLE_TYPE_LIGHT) ? limit_light : limit_heavy;

        radar_status_t status = RADAR_STATUS_NORMAL;

        if (sample.speed_kmh > limit) {
            status = RADAR_STATUS_INFRACTION;
        } else {
            uint32_t warn_threshold = (limit * warn_pct) / 100U;
            if (sample.speed_kmh >= warn_threshold) {
                status = RADAR_STATUS_WARNING;
            } else {
                status = RADAR_STATUS_NORMAL;
            }
        }

        struct display_msg dmsg = {0};
        dmsg.sample = sample;
        dmsg.status = status;
        dmsg.plate[0] = '\0';
        dmsg.plate_valid = false;

        if (status == RADAR_STATUS_INFRACTION) {
            /* Dispara câmera via ZBUS */
            struct camera_msg cmsg = {
                .trigger = true,
                .done = false,
                .plate_valid = false,
                .plate = {0},
            };

            int err = zbus_chan_pub(&camera_chan, &cmsg, K_MSEC(100));
            if (err != 0) {
                LOG_ERR("Erro ao publicar trigger da camera: %d", err);
            } else {
                /* Aguarda a câmera escrever o resultado de volta */
                err = zbus_chan_read(&camera_chan, &cmsg, K_MSEC(1000));
                if (err == 0 && cmsg.done) {
                    strncpy(dmsg.plate, cmsg.plate, sizeof(dmsg.plate) - 1);
                    dmsg.plate[sizeof(dmsg.plate) - 1] = '\0';
                    dmsg.plate_valid = cmsg.plate_valid;
                }
            }
        }

        int ret = k_msgq_put(&g_display_msgq, &dmsg, K_MSEC(100));
        if (ret != 0) {
            LOG_WRN("Fila de display cheia, descartando mensagem");
        }
    }
}
```

## src/display.c
```c
#include <zephyr/kernel.h>
#include <zephyr/logging/log.h>
#include "radar.h"

LOG_MODULE_REGISTER(radar_display, LOG_LEVEL_INF);

/* Códigos ANSI simples */
#define ANSI_RESET   "\x1b[0m"
#define ANSI_GREEN   "\x1b[32m"
#define ANSI_YELLOW  "\x1b[33m"
#define ANSI_RED     "\x1b[31m"

void display_thread(void *p1, void *p2, void *p3)
{
    ARG_UNUSED(p1);
    ARG_UNUSED(p2);
    ARG_UNUSED(p3);

    while (1) {
        struct display_msg msg;

        if (k_msgq_get(&g_display_msgq, &msg, K_FOREVER) == 0) {
            const char *status_str = "NORMAL";
            const char *color = ANSI_GREEN;

            switch (msg.status) {
            case RADAR_STATUS_NORMAL:
                status_str = "NORMAL";
                color = ANSI_GREEN;
                break;
            case RADAR_STATUS_WARNING:
                status_str = "ALERTA";
                color = ANSI_YELLOW;
                break;
            case RADAR_STATUS_INFRACTION:
                status_str = "INFRACAO";
                color = ANSI_RED;
                break;
            default:
                break;
            }

            const char *type_str =
                (radar_classify_vehicle(msg.sample.axes) == VEHICLE_TYPE_LIGHT)
                    ? "LEVE" : "PESADO";

            if (msg.plate[0] != '\0') {
                printk("%s[RADAR] %s | %u km/h | %s | placa=%s (%s)%s\n",
                       color,
                       status_str,
                       msg.sample.speed_kmh,
                       type_str,
                       msg.plate,
                       msg.plate_valid ? "valida" : "invalida",
                       ANSI_RESET);
            } else {
                printk("%s[RADAR] %s | %u km/h | %s%s\n",
                       color,
                       status_str,
                       msg.sample.speed_kmh,
                       type_str,
                       ANSI_RESET);
            }
        }
    }
}
```

## src/sensors.c
```c
#include <zephyr/kernel.h>
#include <zephyr/logging/log.h>
#include <zephyr/random/random.h>

#include "radar.h"

LOG_MODULE_REGISTER(radar_sensors, LOG_LEVEL_INF);

/* Esta thread apenas SIMULA os sensores.
 * Em uma versão mais completa, você pode substituir essa simulação pelo
 * uso real de GPIOs/interrupts conforme o enunciado do trabalho.
 */
void sensors_thread(void *p1, void *p2, void *p3)
{
    ARG_UNUSED(p1);
    ARG_UNUSED(p2);
    ARG_UNUSED(p3);

    while (1) {
        struct sensor_sample sample = {0};

        /* Simula número de eixos: 2 (leve) ou 3 (pesado) */
        uint32_t r = sys_rand32_get() % 2U; /* 0 ou 1 */
        sample.axes = (r == 0U) ? 2U : 3U;

        /* Simula velocidade entre 30 km/h e 140 km/h */
        uint32_t base = 30U;
        uint32_t span = 110U;
        sample.speed_kmh = base + (sys_rand32_get() % span);

        int ret = k_msgq_put(&g_sensor_msgq, &sample, K_MSEC(100));
        if (ret != 0) {
            LOG_WRN("Fila de sensores cheia, descartando amostra");
        }

        /* Intervalo entre leituras simuladas */
        k_sleep(K_SECONDS(3));
    }
}
```

## src/utils.c
```c
#include <ctype.h>
#include <string.h>
#include <zephyr/random/random.h>
#include "radar.h"

/* Cálculo simples de velocidade em km/h
 * distance_mm: distância entre sensores em milímetros
 * time_ms: tempo entre detecção nos sensores em milissegundos
 *
 * Fórmula: v[km/h] = (distance_mm / time_ms) * 3.6
 */
uint32_t radar_calc_speed_kmh(uint32_t distance_mm, uint32_t time_ms)
{
    if (time_ms == 0U) {
        return 0U;
    }

    double v_mps = ((double)distance_mm / (double)time_ms);
    double v_kmh = v_mps * 3.6;

    if (v_kmh < 0.0) {
        return 0U;
    }

    return (uint32_t)(v_kmh + 0.5); /* arredonda */
}

vehicle_type_t radar_classify_vehicle(uint32_t axes)
{
    if (axes >= 3U) {
        return VEHICLE_TYPE_HEAVY;
    }
    return VEHICLE_TYPE_LIGHT;
}

/* Valida um formato simples de placa Mercosul: LLLNLNN
 * (3 letras, 1 dígito, 1 letra, 2 dígitos)
 */
bool radar_validate_plate(const char *plate)
{
    if (!plate) {
        return false;
    }

    if (strlen(plate) != 7U) {
        return false;
    }

    /* LLL */
    for (int i = 0; i < 3; i++) {
        if (!isalpha((unsigned char)plate[i])) {
            return false;
        }
    }

    /* N */
    if (!isdigit((unsigned char)plate[3])) {
        return false;
    }

    /* L */
    if (!isalpha((unsigned char)plate[4])) {
        return false;
    }

    /* NN */
    if (!isdigit((unsigned char)plate[5]) ||
        !isdigit((unsigned char)plate[6])) {
        return false;
    }

    return true;
}

/* Gera uma placa aleatória e marca se ela é válida ou não,
 * de acordo com a taxa de falha configurada.
 */
void radar_generate_plate(char *out, size_t len, bool *valid)
{
    if (!out || len < 8U || !valid) {
        return;
    }

    /* Decide se a placa será válida ou inválida */
    uint32_t fail_rate = CONFIG_RADAR_CAMERA_FAILURE_RATE_PERCENT;
    uint32_t r = sys_rand32_get() % 100U;
    bool is_valid = (r >= fail_rate);

    if (is_valid) {
        /* AAA1A23 */
        for (int i = 0; i < 3; i++) {
            out[i] = 'A' + (sys_rand32_get() % 26U);
        }
        out[3] = '0' + (sys_rand32_get() % 10U);
        out[4] = 'A' + (sys_rand32_get() % 26U);
        out[5] = '0' + (sys_rand32_get() % 10U);
        out[6] = '0' + (sys_rand32_get() % 10U);
        out[7] = '\0';
    } else {
        /* Gera uma string aleatória de 7 chars que provavelmente é inválida */
        for (int i = 0; i < 7; i++) {
            uint32_t v = sys_rand32_get() % 36U; /* 26 letras + 10 dígitos */
            if (v < 26U) {
                out[i] = 'A' + v;
            } else {
                out[i] = '0' + (v - 26U);
            }
        }
        out[7] = '\0';
    }

    *valid = is_valid && radar_validate_plate(out);
}
```
